/**************************************************************************************************************************************************
* File name     : LoRaWAn.ino
* Compiler      : 
* Autor         : VIGASAN   
* Created       : 03/04/2023
* Modified      : 
* Last modified :
*
*
* Description   : Youtube Video https://youtu.be/zhn9FjdwVoM
*
* Other info    : 
**************************************************************************************************************************************************/


/*-----------------------------------------------------------------------------------------------------------------------------------------------*/
/*------------------------------------Include Files----------------------------------------------------------------------------------------------*/
/*-----------------------------------------------------------------------------------------------------------------------------------------------*/
#include "DHT.h"

/*-----------------------------------------------------------------------------------------------------------------------------------------------*/
/*------------------------------------  Constants  ----------------------------------------------------------------------------------------------*/
/*-----------------------------------------------------------------------------------------------------------------------------------------------*/
#define ST_COMM_IDLE	    0
#define ST_COMM_AT	        1 
#define ST_COMM_JOIN        2
#define ST_COMM_WAIT_JOIN   3

#define DHTTYPE             DHT22

/*-----------------------------------------------------------------------------------------------------------------------------------------------*/
/*------------------------------------I/O Definitions--------------------------------------------------------------------------------------------*/
/*-----------------------------------------------------------------------------------------------------------------------------------------------*/
const int DHTPIN = 22;

/*-----------------------------------------------------------------------------------------------------------------------------------------------*/
/*------------------------------------Global variables-------------------------------------------------------------------------------------------*/
/*-----------------------------------------------------------------------------------------------------------------------------------------------*/
int                 g_CommStatus = ST_COMM_IDLE;
unsigned long       g_Time = 0;
unsigned long       g_TimeSensorReading = 0;
String              g_inATString;
DHT                 g_dht(DHTPIN, DHTTYPE);
float               g_Humidity = 0.0;
float               g_Temperature = 0.0;
bool                g_NetworkJoined = false;

/*-----------------------------------------------------------------------------------------------------------------------------------------------*/
/*------------------------------------ SETUP ----------------------------------------------------------------------------------------------------*/
/*-----------------------------------------------------------------------------------------------------------------------------------------------*/
void setup() 
{
    g_dht.begin();
    
	Serial.begin(115200); 		// Serial 1 for monitoring 
    Serial2.begin(9600);		// Serial 2 (PIN 16 and PIN 17) is connected to LoRa module
    delay(500); 				
	
	Serial.println("");
    Serial.println("");
    Serial.println("-------- LoRaWan Test ----------");
}

/*-----------------------------------------------------------------------------------------------------------------------------------------------*/
/*------------------------------------ LOOP -----------------------------------------------------------------------------------------------------*/
/*-----------------------------------------------------------------------------------------------------------------------------------------------*/
void loop() 
{
    /////////////////////////////////////////////////////////////////////////////////////////////////////////////////////////////////////////////
    // Incoming Data from Lora Module
    //////////////////////////////////////////////////////////////////////////////////////////////////////////////////////////////////////////////
    if (Serial2.available() > 0)
    {
        g_inATString = Serial2.readString();
        g_inATString.trim();
		Serial.println(g_inATString);
        if(g_CommStatus == ST_COMM_WAIT_JOIN)
        {
            if(g_inATString == "+EVT:JOINED")
                g_NetworkJoined = true;
        }
	}
    //////////////////////////////////////////////////////////////////////////////////////////////////////////////////////////////////////////////
    // AT COMMANDS SEQUENCE
    //////////////////////////////////////////////////////////////////////////////////////////////////////////////////////////////////////////////
	if(millis() - g_Time > 2000)
    {
        g_Time = millis();
		switch(g_CommStatus)
		{ 
			case ST_COMM_IDLE:
			{
				g_CommStatus = ST_COMM_AT;
			} break;
			
			case ST_COMM_AT:
			{
                Serial.println("Send AT");
				Serial2.write("AT\r");
				g_CommStatus = ST_COMM_JOIN;
			} break;

            case ST_COMM_JOIN:
            {
                Serial.println("Join Helium: ");
                Serial2.write("AT+JOIN=1\r");
                g_CommStatus = ST_COMM_WAIT_JOIN;
            } break;
		}
	}
	
	//////////////////////////////////////////////////////////////////////////////////////////////////////////////////////////////////////////////
    // Reading DHT22 for Temperature and Humidity
    //////////////////////////////////////////////////////////////////////////////////////////////////////////////////////////////////////////////
    if(millis() - g_TimeSensorReading > 60000)  // Reads data every 1 min
    {
        g_TimeSensorReading = millis();

        g_Temperature = g_dht.readTemperature();
        g_Humidity = g_dht.readHumidity();

        Serial.print("Temperature: ");
        Serial.print(g_Temperature);
        Serial.println(" °C");

        Serial.print("Humidity: ");
        Serial.print(g_Humidity);
        Serial.println(" %");


        // SEND DATA if network is joined
        if(g_NetworkJoined == true)
        {
            int decTemp = (int)(g_Temperature * 10);
            byte hiTemp = byte(decTemp >> 8);
            byte loTemp = byte(decTemp & 0x00FF);
            byte loHum = (byte)(g_Humidity * 2);
            char dataString[50] = {0};
            sprintf(dataString, "AT+SEND=1:1:0167%02X%02X0268%02X\r", hiTemp, loTemp, loHum);
            Serial.print("DATA to send: ");
            Serial.println(dataString);
            Serial2.write(dataString);
        }
    }
}
